## bsp/nuvoton/numaker-pfm-m487/board/Kconfig
```kconfig
menu "Hardware Drivers Config"

    menu "On-chip Peripheral Drivers"
        source "$(BSP_DIR)/../libraries/cortex-m/Kconfig_M480"
    endmenu

    menu "On-board Peripheral Drivers"

        config BSP_USING_NULINKME
            bool "Enable UART0 for RTT Console(uart0)"
            select BSP_USING_UART
            select BSP_USING_UART0
            default y

        config BOARD_USING_IP101GR
            bool "Enable ethernet phy supporting(over emac/mdio)"
            select BSP_USING_EMAC
            default n

        config BOARD_USING_NAU88L25
            bool "NAU88L25 Audio Codec supporting(over i2s, i2c2)"
            select NU_PKG_USING_NAU88L25
            select BSP_USING_I2C2
            select BSP_USING_I2S
            select BSP_USING_I2S0
            default n

        config BOARD_USING_STORAGE_SDCARD
            bool "SDCARD supporting(over sdh0)"
            select BSP_USING_SDH
            select BSP_USING_SDH0
            default n

        config BOARD_USING_QSPI_FLASH
            bool "SPIFLASH supporting(over qspi0)"
            select BSP_USING_QSPI
            select BSP_USING_QSPI0
            select NU_PKG_USING_QSPINOR
            default y

        choice
            prompt "Select USB Port"

            config BOARD_USING_USBD
                select BSP_USING_USB
                select BSP_USING_USBD
                bool "Enable USBD"
                help
                    Choose this option if you need USBD function mode.

            config BOARD_USING_USBH
                select BSP_USING_USB
                select BSP_USING_USBH
                bool "Enable USBH"
                help
                    Choose this option if you need USBH function mode.

            config BOARD_USING_OTG
                select BSP_USING_OTG
                bool "Enable USB OTG"
                help
                    Choose this option if you need USB Device, Host and H/W OTG function.

            config BOARD_USING_USB_NONE
                bool "Disable USB port"
                help
                    Choose this option if you need not USB function.
        endchoice

        choice
            prompt "Select HSUSB Port"

            config BOARD_USING_HSUSBD
                select BSP_USING_USB
                select BSP_USING_HSUSBD
                bool "Enable HSUSBD"
                help
                    Choose this option if you need HSUSBD function mode.

            config BOARD_USING_HSUSBH
                select BSP_USING_USB
                select BSP_USING_HSUSBH
                bool "Enable HSUSBH"
                help
                    Choose this option if you need HSUSBH function mode.

            config BOARD_USING_HSOTG
                select BSP_USING_HSOTG
                bool "Enable HSUSB OTG"
                help
                    Choose this option if you need HSUSB Device, Host and H/W OTG function.

            config BOARD_USING_HSUSB_NONE
                bool "Disable HSUSB port"
                help
                    Choose this option if you need not USB function.
        endchoice

    endmenu

    menu "Board extended module drivers"
    endmenu

    source "$(BSP_DIR)/../libraries/nu_packages/Kconfig"

endmenu
```
