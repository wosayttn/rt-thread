## bsp/nuvoton/numaker-m2l31ki/board/Kconfig
```kconfig
menu "Hardware Drivers Config"

    menu "On-chip Peripheral Drivers"
        source "$(BSP_DIR)/../libraries/cortex-m/Kconfig_M2L31"
    endmenu

    menu "On-board Peripheral Drivers"

        config BOARD_USING_NULINKME
            bool "Enable UART0 for RTT Console(uart0)"
            select BSP_USING_UART
            select BSP_USING_UART0
            default y

        config BOARD_USING_USBD
            bool "Enable USB 2.0 Full-Speed Device(usbd)"
            select BSP_USING_USB
            select BSP_USING_USBD
            default n

    endmenu

    source "$(BSP_DIR)/../libraries/nu_packages/Kconfig"

endmenu
```

## bsp/nuvoton/numaker-m3351kj/board/Kconfig
```kconfig
menu "Hardware Drivers Config"

    menu "On-chip Peripheral Drivers"
        source "$(BSP_DIR)/../libraries/cortex-m/Kconfig_M3351"
    endmenu

    menu "On-board Peripheral Drivers"

        config BOARD_USING_NULINKME
            bool "Enable UART0 for RTT Console.(uart0)"
            select BSP_USING_UART
            select BSP_USING_UART0
            default y

        config BSP_USING_CUSTOM_LOADER
            bool "Enable Custom Loader for Swapping Flash Bank."
            select BSP_USING_FMC

        config BOARD_USING_USBD
            select BSP_USING_USBD
            bool "Enable USBD"
            help
                Choose this option if you need USBD function mode.

    endmenu

    menu "Board extended module drivers"
    choice
        prompt "Select On-board Module"
        config BOARD_USING_NONE
            bool "None"
        config BOARD_USING_NUTFT
            bool "NuTFT V1.3"
    endchoice

    if BOARD_USING_NUTFT
        source "$(BSP_DIR)/board/Kconfig_Board_NUTFT"
    endif
    endmenu

    source "$(BSP_DIR)/../libraries/nu_packages/Kconfig"

endmenu
```

## bsp/nuvoton/numaker-m5531/board/Kconfig
```kconfig
menu "Hardware Drivers Config"

    menu "On-chip Peripheral Drivers"
        source "$(BSP_DIR)/../libraries/cortex-m/Kconfig_M5531"
    endmenu

    menu "On-board Peripheral Drivers"

        config BOARD_USING_NULINKME
            bool "Enable UART0 for RTT Console.(uart0)"
            select BSP_USING_UART
            select BSP_USING_UART0
            default y
    endmenu

    menu "Board extended module drivers"

        config BOARD_USING_NUTFT
            bool "Nu_TFT V1.3"
            default n

        if BOARD_USING_NUTFT

            config BOARD_USING_LCD_ILI9341
                bool "Enable LCM(Over SPI2)"
                select BSP_USING_SPI
                select BSP_USING_SPI2
                select NU_PKG_USING_ILI9341
                select NU_PKG_ILI9341_HORIZONTAL
                default y

                if BOARD_USING_LCD_ILI9341

                    config BOARD_USING_ILI9341_PIN_BACKLIGHT
                        int "Specify the pin index of backlight pin index"
                        range 0 127
                        default 21

                    config BOARD_USING_ILI9341_PIN_RESET
                        int "Specify the pin index of reset pin index"
                        range 0 127
                        default 19

                    config BOARD_USING_ILI9341_PIN_DC
                        int "Specify the pin index of data&command switching"
                        range 0 127
                        default 18

                endif

            config BOARD_USING_NUTFT_ADC_TOUCH
                bool "Enable ADC Touching(Over EADC0)"
                select BSP_USING_EADC
                select BSP_USING_EADC0
                select RT_USING_TOUCH
                select NU_PKG_USING_ADC_TOUCH
                default y

            config BOARD_USING_QSPI_FLASH
                bool "Enable QSPI Flash(Over QSPI0)"
                select BSP_USING_SPI
                select BSP_USING_QSPI
                select BSP_USING_QSPI0
                select RT_USING_FAL
                select RT_USING_SFUD
                select RT_USING_QSPI
                default y
        endif

    endmenu

    source "$(BSP_DIR)/../libraries/nu_packages/Kconfig"

endmenu
```
