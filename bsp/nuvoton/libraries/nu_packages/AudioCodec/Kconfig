## bsp/nuvoton/libraries/nu_packages/AudioCodec/Kconfig
```kconfig
menu "Audio Codecs"

    config NU_PKG_USING_NAU88L25
        bool "NAU88L25 Audio Codec."
        select BSP_USING_I2C
        default n

    config NU_PKG_USING_NAU8822
        bool "NAU8822 Audio Codec."
        select BSP_USING_I2C
        default n

endmenu
```

## bsp/nuvoton/libraries/nu_packages/Demo/Kconfig
```kconfig
menu "Demo"

    config NU_PKG_USING_DEMO
        bool "Built-in Demo."
        default n

endmenu
```

## bsp/nuvoton/libraries/nu_packages/Displays/Kconfig
```kconfig
menu "Displays"

    config NU_PKG_USING_ILI9341
        bool "ILI9341 LCD Panel"
        select BSP_USING_GPIO
        default n

        if NU_PKG_USING_ILI9341

            choice
                prompt "Select ili9341 interface"
                default NU_PKG_USING_ILI9341_SPI if BOARD_USING_ILI9341_SPI_INTERFACE
                default NU_PKG_USING_ILI9341_EBI if BOARD_USING_ILI9341_EBI_INTERFACE

                config NU_PKG_USING_ILI9341_SPI
                    select BSP_USING_SPI
                    bool "ILI9341_SPI"
                help
                    Choose this option if you the ili9341 device is with SPI interface.

                config NU_PKG_USING_ILI9341_EBI
                    select BSP_USING_EBI
                    bool "ILI9341_EBI"
                help
                    Choose this option if you the ili9341 device is with EBI interface.
            endchoice

            if NU_PKG_USING_ILI9341_SPI
                config NU_PKG_USING_ILI9341_SPI_CLK_FREQ
                    int "Set SPI Clock frequency"
                    default 48000000
            endif

            config NU_PKG_ILI9341_WITH_OFFSCREEN_FRAMEBUFFER
                bool "Create an offscreen framebuffer."
                default n

            if NU_PKG_ILI9341_WITH_OFFSCREEN_FRAMEBUFFER
                config NU_PKG_ILI9341_LINE_BUFFER_NUMBER
                    int "Allocate Line buffer number."
                    range 1 240
                    default 240
            endif

            config NU_PKG_ILI9341_HORIZONTAL
                bool
                default y

            config BSP_LCD_BPP
                int
                default 16     if NU_PKG_USING_ILI9341

            config BSP_LCD_WIDTH
                int
                default 320    if NU_PKG_ILI9341_HORIZONTAL

            config BSP_LCD_HEIGHT
                int
                default 240    if NU_PKG_ILI9341_HORIZONTAL

        endif

    config NU_PKG_USING_SSD1963
        bool "SSD1963 LCD Panel"
        select BSP_USING_GPIO
        default n

        if NU_PKG_USING_SSD1963

            choice
                prompt "Select SSD1963 interface"
                default NU_PKG_USING_SSD1963_EBI

                config NU_PKG_USING_SSD1963_EBI
                    select BSP_USING_EBI
                    bool "SSD1963_EBI"
                help
                    Choose this option if you the SSD1963 device is with EBI interface.
            endchoice

            config NU_PKG_SSD1963_WITH_OFFSCREEN_FRAMEBUFFER
                bool "Create an offscreen framebuffer."
                default n

            if NU_PKG_SSD1963_WITH_OFFSCREEN_FRAMEBUFFER
                config NU_PKG_SSD1963_LINE_BUFFER_NUMBER
                    int "Allocate Line buffer number."
                    range 16 272
                    default  272
            endif

            config BSP_LCD_BPP
                int
                default 16     if NU_PKG_USING_SSD1963

            config BSP_LCD_WIDTH
                int
                default 480    if NU_PKG_USING_SSD1963

            config BSP_LCD_HEIGHT
                int
                default 272    if NU_PKG_USING_SSD1963

        endif

    config NU_PKG_USING_FSA506
        bool "FSA506 LCD Panel"
        select BSP_USING_GPIO
        default n

        if NU_PKG_USING_FSA506

            choice
                prompt "Select FSA506 interface"
                default NU_PKG_USING_FSA506_EBI

                config NU_PKG_USING_FSA506_EBI
                    select BSP_USING_EBI
                    bool "FSA506_EBI"
                help
                    Choose this option if you the FSA506 device is with EBI interface.
            endchoice

            config NU_PKG_FSA506_WITH_OFFSCREEN_FRAMEBUFFER
                bool "Create an offscreen framebuffer."
                default n

            if NU_PKG_FSA506_WITH_OFFSCREEN_FRAMEBUFFER
                config NU_PKG_FSA506_LINE_BUFFER_NUMBER
                    int "Allocate Line buffer number."
                    range 16 272
                    default  272
            endif

            config BSP_LCD_BPP
                int
                default 16     if NU_PKG_USING_FSA506

            config BSP_LCD_WIDTH
                int
                default 480    if NU_PKG_USING_FSA506

            config BSP_LCD_HEIGHT
                int
                default 272    if NU_PKG_USING_FSA506

        endif

    config NU_PKG_USING_LT7381
        bool "LT7381 LCD Panel"
        select BSP_USING_GPIO
        default n

        if NU_PKG_USING_LT7381

            choice
                prompt "Select LT7381 interface"

                config NU_PKG_USING_LT7381_EBI
                    select BSP_USING_EBI
                    bool "LT7381_EBI"
                help
                    Choose this option if you the LT7381 device is with EBI interface.
            endchoice

            config NU_PKG_LT7381_WITH_OFFSCREEN_FRAMEBUFFER
                bool "Create an offscreen framebuffer."
                default n

            if NU_PKG_LT7381_WITH_OFFSCREEN_FRAMEBUFFER
                config NU_PKG_LT7381_LINE_BUFFER_NUMBER
                    int "Allocate Line buffer number."
                    range 16 480
                    default  480
            endif

            config BSP_LCD_BPP
                int
                default 16     if NU_PKG_USING_LT7381

            config BSP_LCD_WIDTH
                int
                default 800    if NU_PKG_USING_LT7381

            config BSP_LCD_HEIGHT
                int
                default 480    if NU_PKG_USING_LT7381

        endif

    if BSP_USING_EBI
        config NU_PKG_EBI_I80_CMD
            hex "EBI I80 Command offset"
            default 0x0

        config NU_PKG_EBI_I80_DATA
            hex "EBI I80 Data offset"
            default 0x0
    endif

    if BSP_USING_DISP

        config NU_PKG_USING_DISPLIB
            bool "DISP Converter"
            select BSP_USING_GPIO
            select BSP_USING_I2C
            select RT_USING_I2C
            select RT_USING_PIN

        if NU_PKG_USING_DISPLIB
            choice
                prompt "Select one DISP converter"

                config NU_PKG_USING_DISPLIB_LT8918
                    bool "RGB to MIPI(LT8918)"
                help
                    Choose this option if you the LT8918 device.

                config NU_PKG_USING_DISPLIB_LT8618
                    bool "RGB to HDMI(LT8618)"
                help
                    Choose this option if you the LT8618 device.

                config NU_PKG_USING_DISPLIB_LT8718
                    bool "RGB to eDP(LT8718)"
                help
                    Choose this option if you the LT8718 device.
            endchoice

            config NU_PKG_USING_DISPLIB_I2C_DEVNAME
                string "Specify I2C Name"
                default "i2c1"
                help
                    Specify I2C device name.

            config NU_PKG_USING_DISPLIB_RST_IDXNUM
                int "Specify Rst Pin Index Number"
                default 204
                help
                    Specify Reset Pin Index Number(Default: PM12).
        endif
    endif

endmenu
```

## bsp/nuvoton/libraries/nu_packages/Kconfig
```kconfig
menu "Nuvoton Packages Config"

    source "$(BSP_DIR)/../libraries/nu_packages/Sensors/Kconfig"

    source "$(BSP_DIR)/../libraries/nu_packages/AudioCodec/Kconfig"

    source "$(BSP_DIR)/../libraries/nu_packages/Displays/Kconfig"

    source "$(BSP_DIR)/../libraries/nu_packages/Touch/Kconfig"

    source "$(BSP_DIR)/../libraries/nu_packages/Storages/Kconfig"

    source "$(BSP_DIR)/../libraries/nu_packages/Others/Kconfig"

    source "$(BSP_DIR)/../libraries/nu_packages/Demo/Kconfig"

endmenu
```

## bsp/nuvoton/libraries/nu_packages/Others/Kconfig
```kconfig
menu "Others"

    config NU_PKG_USING_CCAP_SENSORS
        bool "CCAP camera sensors."
        default y if BSP_USING_CCAP
        default n

    config NU_PKG_USING_DA9062
        bool "DA9062 PMIC."
        select BSP_USING_I2C
        default n

    config NU_PKG_USING_RV3032C7
        bool "Using RV3032-C7 RTC."
        select RT_USING_RTC
        default n

    config NU_PKG_USING_NUUTILS
        bool "Nuvoton utility headers."
        default y

    config NU_PKG_USING_LV_PORT
        bool "LVGL port."
        depends on PKG_USING_LVGL
        default y if PKG_USING_LVGL
        default n

    config NU_PKG_USING_NUWRITER
        bool "NuWriter packfile support."
        depends on USE_MA35_AARCH32 && RT_USING_DFS
        default y if USE_MA35_AARCH32 && RT_USING_DFS
        default n

endmenu
```

## bsp/nuvoton/libraries/nu_packages/Sensors/Kconfig
```kconfig
menu "Sensors"

    config NU_PKG_USING_BMX055
        bool "BMX055 9-axis sensor."
        select RT_USING_I2C
        select RT_USING_SENSOR
        select RT_USING_SENSOR_V2
        default n

    config NU_PKG_USING_MAX31875
        bool "MAX31875 Temperature sensor."
        select RT_USING_I2C
        select RT_USING_SENSOR
        select RT_USING_SENSOR_V2
        default n

    config NU_PKG_USING_NCT7717U
        bool "NCT7717U Temperature sensor."
        select RT_USING_I2C
        select RT_USING_SENSOR
        select RT_USING_SENSOR_V2
        default n

    config NU_PKG_USING_TMP112
        bool "TMP112 Temperature sensor."
        select RT_USING_I2C
        select RT_USING_SENSOR
        default n

    config NU_PKG_USING_LIS3DH
        bool "LIS3DH 3-AXIS Accelerator sensor."
        select RT_USING_I2C
        select RT_USING_SENSOR
        select RT_USING_SENSOR_V2
        default n

    config NU_PKG_USING_LPS22HH
        bool "LPS22HH Barometer sensor."
        select RT_USING_I2C
        select RT_USING_SENSOR
        select RT_USING_SENSOR_V2
        default n

endmenu
```

## bsp/nuvoton/libraries/nu_packages/Storages/Kconfig
```kconfig
menu "Storages"

    config NU_PKG_USING_QSPINOR
        bool "QSPI NOR flash."
        select BSP_USING_SPI
        select BSP_USING_QSPI
        default y if BOARD_USING_QSPI_FLASH
        default n

    config NU_PKG_USING_SPINAND
        bool "SPI NAND flash."
        select BSP_USING_QSPI
        select RT_USING_MTD_NAND
        default n

endmenu
```

## bsp/nuvoton/libraries/nu_packages/Touch/Kconfig
```kconfig
menu "Touch"

    config NU_PKG_USING_TPC
        bool "Support Touch Panel Controller over I2C"
        select RT_USING_TOUCH
        select RT_TOUCH_PIN_IRQ
        select RT_USING_I2C

    if NU_PKG_USING_TPC
        choice
            prompt "Select TPC drivers"
            default NU_PKG_USING_TPC_ILI if BOARD_USING_ILI2130
            default NU_PKG_USING_TPC_GT911 if BOARD_USING_GT911
            default NU_PKG_USING_TPC_ST1663I if BOARD_USING_ST1663I

            config NU_PKG_USING_TPC_ILI
                bool "ILI Series TPC"

            config NU_PKG_USING_TPC_GT911
                bool "GT911 TPC"

            config NU_PKG_USING_TPC_FT5446
                bool "FT5446 TPC"

            config NU_PKG_USING_TPC_ST1663I
                bool "ST1663I TPC"

        endchoice

        config NU_PKG_TPC_REVERSE_XY
            bool "Reverse X-Y coordinate"
            default n

    endif

    config NU_PKG_USING_ADC_TOUCH
        bool "ADC touch function"
        default n

    if NU_PKG_USING_ADC_TOUCH
        choice
            prompt "Select TPC drivers"
            default NU_PKG_USING_ADC_TOUCH_SW if BOARD_USING_NUFUN_ADC_TOUCH || BOARD_USING_NUTFT_ADC_TOUCH || BOARD_USING_LCD_ILI9341

        config NU_PKG_USING_ADC_TOUCH_HW
            bool "Using HW ADC touch"

        config NU_PKG_USING_ADC_TOUCH_SW
            bool "Using SW ADC touch"
            select RT_USING_ADC

        config NU_PKG_USING_ADC_TOUCH_SERIAL
            bool "Serial touch function"
            select RT_USING_SERIAL

        endchoice

        if NU_PKG_USING_ADC_TOUCH_SERIAL
            config NU_PKG_SERIAL_TOUCH_DEVNAME
                string "uart1"
                default "uart1"
        endif
    endif

endmenu
```

## bsp/nuvoton/numaker-m467hj/UTEST/Kconfig
```kconfig
config UTEST_CMD_PREFIX
    string
    default "numicro.bsp.utest." if BOARD_USE_UTEST

config BOARD_USE_UTEST
    bool
    select RT_USING_UTEST
    default y
```
